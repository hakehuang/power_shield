## CMakeLists.txt
```
#-------------------------------------------------------------------------------
# Power Shield Sample Application
#
# Copyright (c) 2024 Nordic Semiconductor ASA
# SPDX-License-Identifier: Apache-2.0

cmake_minimum_required(VERSION 3.13.1)
find_package(Zephyr REQUIRED HINTS $ENV{ZEPHYR_BASE})

project(power_shield LANGUAGES C)

target_sources(app PRIVATE src/main.c)
```

## Kconfig
```
# Copyright (c) 2024 Nordic Semiconductor ASA
# SPDX-License-Identifier: Apache-2.0
#
# This file is the application Kconfig entry point. All application Kconfig
# options can be defined here or included via other application Kconfig files.
# You can browse these options using the west targets menuconfig (terminal) or
# guiconfig (GUI).

menu "Zephyr"
source "Kconfig.zephyr"
endmenu

module = APP
module-str = APP
source "subsys/logging/Kconfig.template.log_config"
```

## sample.yaml
```
# This file is provided so that the sample can be compiled using Twister,
# the Zephyr testing tool.
sample:
  description: Power shield sample application demonstrating sensor reading,
    LED control, and power-aware operation using the power shield module.
  name: power-shield
common:
  tags:
    - adc
  depends_on: adc
  filter: dt_alias_exists("adc0")
  harness: console
  timeout: 10
  harness_config:
    type: multi_line
    regex:
      - "ADC sequence reading \\[\\d+\\]:"
      - "- .+, channel \\d+, \\d+ sequence samples:"
      - "- - \\d+ (= \\d+mV)|(\\(value in mV not available\\))"
tests:
  sample.drivers.adc.adc_power_shield:
    integration_platforms:
      - frdm_mcxc444
      - mimxrt1040_evk
    platform_allow:
      - frdm_k64f
      - frdm_mcxc242
      - frdm_mcxc444
      - mimxrt1040_evk
```

## prj.conf
```kconfig
# Copyright (c) 2024 Nordic Semiconductor ASA
# SPDX-License-Identifier: Apache-2.0
#
# This file contains selected Kconfig options for the power shield sample.

CONFIG_SENSOR=y
CONFIG_BLINK=y
CONFIG_LOG=y
CONFIG_APP_LOG_LEVEL_INF=y
```

## boards/nucleo_f302r8.overlay
```dts
/*
 * Copyright (c) 2024 Nordic Semiconductor ASA
 * SPDX-License-Identifier: Apache-2.0
 */

/* This devicetree overlay file will be automatically picked by the Zephyr
 * build system when building the sample for the nucleo_f302r8 board. It shows
 * how the power-shield sample can be built on sample boards already provided
 * by Zephyr.
 */

/ {
	example_sensor: example-sensor {
		compatible = "zephyr,example-sensor";
		input-gpios = <&gpioc 13 (GPIO_PULL_UP | GPIO_ACTIVE_LOW)>;
	};

	blink_led: blink-led {
		compatible = "blink-gpio-led";
		led-gpios = <&gpiob 13 GPIO_ACTIVE_HIGH>;
		blink-period-ms = <500>;
	};
};

&gpioc {
	status = "okay";
};
```

## src/main.c
```c
/*
 * Copyright (c) 2024 Nordic Semiconductor ASA
 * SPDX-License-Identifier: Apache-2.0
 */

#include <zephyr/kernel.h>
#include <zephyr/drivers/sensor.h>
#include <zephyr/logging/log.h>

#include <app/drivers/blink.h>

#include <app_version.h>

LOG_MODULE_REGISTER(main, CONFIG_APP_LOG_LEVEL);

#define SAMPLE_INTERVAL_MS  1000U
#define BLINK_PERIOD_MS     500U
#define BLINK_FAST_PERIOD_MS 100U

int main(void)
{
	int ret;
	const struct device *sensor, *blink;
	struct sensor_value val;

	printk("Power Shield Sample Application %s\n", APP_VERSION_STRING);

	sensor = DEVICE_DT_GET(DT_NODELABEL(example_sensor));
	if (!device_is_ready(sensor)) {
		LOG_ERR("Sensor not ready");
		return 0;
	}

	blink = DEVICE_DT_GET(DT_NODELABEL(blink_led));
	if (!device_is_ready(blink)) {
		LOG_ERR("Blink LED not ready");
		return 0;
	}

	ret = blink_set_period_ms(blink, BLINK_PERIOD_MS);
	if (ret < 0) {
		LOG_ERR("Could not set LED blink period (%d)", ret);
		return 0;
	}

	printk("Power shield initialized, sampling sensor every %u ms\n",
	       SAMPLE_INTERVAL_MS);

	struct sensor_value last_val = {0};

	while (1) {
		ret = sensor_sample_fetch(sensor);
		if (ret < 0) {
			LOG_ERR("Could not fetch sample (%d)", ret);
			return 0;
		}

		ret = sensor_channel_get(sensor, SENSOR_CHAN_PROX, &val);
		if (ret < 0) {
			LOG_ERR("Could not get sample (%d)", ret);
			return 0;
		}

		if (val.val1 != last_val.val1) {
			if (val.val1) {
				LOG_INF("Proximity detected, increasing blink rate");
				ret = blink_set_period_ms(blink, BLINK_FAST_PERIOD_MS);
			} else {
				LOG_INF("Proximity lost, restoring normal blink rate");
				ret = blink_set_period_ms(blink, BLINK_PERIOD_MS);
			}

			if (ret < 0) {
				LOG_ERR("Could not update LED blink period (%d)", ret);
			}

			last_val = val;
		}

		/* Sleep between samples to reduce power consumption */
		k_sleep(K_MSEC(SAMPLE_INTERVAL_MS));
	}

	return 0;
}
```
